## boards/arm/nrf51_pca20009/Kconfig.defconfig
```kconfig
# Kconfig - nRF51 PCA10028 board configuration
#
# Copyright (c) 2016 Linaro Limited.
#
# SPDX-License-Identifier: Apache-2.0

if BOARD_NRF51_PCA20009	

config BOARD
	default BOARD_NRF51_PCA20009	

if GPIO_NRF5

config GPIO_NRF5_P0
	default y

endif # GPIO_NRF5

if UART_NRF5

config UART_NRF5_GPIO_TX_PIN
	default 9

config UART_NRF5_GPIO_RX_PIN
	default 10


endif # UART_NRF5

endif # BOARD_NRF51_PCA20009
```

## boards/arm/nrf51_pca20009/nrf51_pca20009_defconfig
```kconfig
CONFIG_ARM=y
CONFIG_SOC_FAMILY_NRF5=y
CONFIG_SOC_SERIES_NRF51X=y
CONFIG_SOC_NRF51822_QFAC=y
CONFIG_BOARD_NRF51_PCA20009=y

# enable console
CONFIG_CONSOLE=y
CONFIG_HAS_SEGGER_RTT=y
CONFIG_RTT_CONSOLE=y

# bluetooth
CONFIG_BT=y
CONFIG_BT_CTLR=y
```

## drivers/sensor/adns3000/Kconfig
```kconfig
# Kconfig - Pixart ADNS-3000 optical mouse sensor
#
# Copyright (c) 2016 Intel Corporation
#
# SPDX-License-Identifier: Apache-2.0
#

menuconfig ADNS3000
	bool "Pixart ADNS-3000 optical mouse sensor"
	depends on SPI
	default n
	help
	  Pixart ADNS-3000 optical mouse sensor

config ADNS3000_NAME
	string 
	prompt "Driver's name"
	depends on ADNS3000
	default "ADNS3000"

config ADNS3000_SPI_PORT_NAME
	string "SPI master controller port name"
	depends on ADNS3000
	default "SPI_1"
	help
	  Master SPI port name through which ADNS3000 chip is accessed.

config ADNS3000_SLAVE
	hex "ADNS3000 SPI slave select pin"
	depends on ADNS3000
	default 23
	help
	  ADNS3000 chip select pin.

config ADNS3000_SPI_BUS_FREQ
	int "ADNS3000 SPI bus speed in Hz"
	default 640000
	depends on ADNS3000
	help
	  This is the maximum supported SPI bus frequency. The chip supports a
	  frequency up to 10MHz.

choice
	prompt "Trigger mode"
	depends on ADNS3000
	default ADNS3000_TRIGGER_NONE
	help
	  Specify the type of triggering to be used by the driver.

config ADNS3000_TRIGGER_NONE
	bool
	prompt "No trigger"

config ADNS3000_TRIGGER_GLOBAL_THREAD
	bool "Use global thread"
	select ADNS3000_TRIGGER

config ADNS3000_TRIGGER_OWN_THREAD
	bool "Use own thread"
	select ADNS3000_TRIGGER
endchoice

config ADNS3000_TRIGGER
	bool
	default n
	depends on ADNS3000

config ADNS3000_THREAD_PRIORITY
	int "Own thread priority"
	depends on ADNS3000 && ADNS3000_TRIGGER_OWN_THREAD
	default 10
	help
	  The priority of the thread used for handling interrupts.

config ADNS3000_THREAD_STACK_SIZE
	int "Own thread stack size"
	depends on ADNS3000 && ADNS3000_TRIGGER_OWN_THREAD
	default 1024
	help
	  The thread stack size.

config ADNS3000_GPIO_DEV_NAME
	string "Gpio device"
	default "GPIO_NRF5_P0"
	depends on ADNS3000 && ADNS3000_TRIGGER
	help
	  The name of the GPIO device to which the ADNS3000 interrupt pin is
	  connected.

config ADNS3000_GPIO_PIN_NUM
	int "Interrupt GPIO pin number"
	default 8
	depends on ADNS3000 && ADNS3000_TRIGGER
	help
	  The number of the GPIO pin which is connected to ADNS3000 interrupt pin.
```

## drivers/spi/Kconfig.nrf5
```kconfig
# Copyright (c) 2017 - 2018, Nordic Semiconductor ASA
#
# SPDX-License-Identifier: Apache-2.0
#

menuconfig SPI_NRF5
	bool "nRF5 SPI drivers"
	depends on SOC_FAMILY_NRF5
	help
	  Enable support for nRF5 MCU series SPI drivers. Peripherals with the
	  same instance id can not be used together, e.g., SPIM_0 and I2C_0
	  (TWIM0) and SPIS_0. You may need to disable I2C_0 or I2C_1.

if SPI_NRF5

# nordic twiX0, spiX0, spi0 instances can not be used at the same time
if SPI_0 && !I2C_0

config SPI_0_NRF5
	bool "nRF5 SPI 0"
	depends on SOC_SERIES_NRF52X || SOC_SERIES_NRF51X
	select NRFX_SPI
	help
	  Enable nRF5 SPI Master without EasyDMA on port 0

if SPI_0_NRF5

config SPI_0_NRF5_SCK_PIN
	int "SCK pin number"
	range 0 47 if SOC_NRF52840_QIAA
	range 0 31
	help
	  GPIO pin number to use for SCK

config SPI_0_NRF5_MOSI_PIN
	int "MOSI pin number"
	range 0 47 if SOC_NRF52840_QIAA
	range 0 31
	help
	  GPIO pin number to use for MOSI

config SPI_0_NRF5_MISO_PIN
	int "MISO pin number"
	range 0 47 if SOC_NRF52840_QIAA
	range 0 31
	help
	  GPIO pin number to use for MISO

config SPI_0_NRF5_ORC
	hex "Over-read Character"
	range 0x00 0xff
	default 0xff
	help
	  Over-read character. Character clocked out after an over-read
	  of the transmit buffer.

endif # SPI_0_NRF5

endif # SPI_0 && !I2C_0

# nordic twiX1, spiX1, spi1 instances can not be used at the same time
if SPI_1 && !I2C_1

config SPI_1_NRF5
	bool "nRF5 SPI 1"
	depends on SOC_SERIES_NRF52X || SOC_SERIES_NRF51X
	select NRFX_SPI
	help
	  Enable nRF5 SPI Master without EasyDMA on port 1

if SPI_1_NRF5

config SPI_1_NRF5_SCK_PIN
	int "SCK pin number"
	range 0 47 if SOC_NRF52840_QIAA
	range 0 31
	help
	  GPIO pin number to use for SCK

config SPI_1_NRF5_MOSI_PIN
	int "MOSI pin number"
	range 0 47 if SOC_NRF52840_QIAA
	range 0 31
	help
	  GPIO pin number to use for MOSI

config SPI_1_NRF5_MISO_PIN
	int "MISO pin number"
	range 0 47 if SOC_NRF52840_QIAA
	range 0 31
	help
	  GPIO pin number to use for MISO

config SPI_1_NRF5_ORC
	hex "Over-read Character"
	range 0x00 0xff
	default 0xff
	help
	  Over-read character. Character clocked out after an over-read
	  of the transmit buffer.

endif # SPI_1_NRF5

endif # SPI_1 && !I2C_1

# nordic twiX2, spiX2, spi2 instances can not be used at the same time
if SPI_2 && !I2C_2

config SPI_2_NRF5
	bool "nRF5 SPI 2"
	depends on SOC_SERIES_NRF52X
	select NRFX_SPI
	help
	  Enable nRF5 SPI Master without EasyDMA on port 2

if SPI_2_NRF5

config SPI_2_NRF5_SCK_PIN
	int "SCK pin number"
	range 0 47 if SOC_NRF52840_QIAA
	range 0 31
	help
	  GPIO pin number to use for SCK

config SPI_2_NRF5_MOSI_PIN
	int "MOSI pin number"
	range 0 47 if SOC_NRF52840_QIAA
	range 0 31
	help
	  GPIO pin number to use for MOSI

config SPI_2_NRF5_MISO_PIN
	int "MISO pin number"
	range 0 47 if SOC_NRF52840_QIAA
	range 0 31
	help
	  GPIO pin number to use for MISO

config SPI_2_NRF5_ORC
	hex "Over-read Character"
	range 0x00 0xff
	default 0xff
	help
	  Over-read character. Character clocked out after an over-read
	  of the transmit buffer.

endif # SPI_2_NRF5

endif # SPI_2 && !I2C_2

endif # SPI_NRF5
```
